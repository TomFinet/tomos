/**
 * Higher-quarter kernel.
 * Virtual address base is 0xc0200000
 * Physical load address is 2MiB = 0x00200000
 * because grub exists below there.
 */

#include <memory/memory_def.h>
#include <linker_sections.h>
	
ENTRY(_start)

SECTIONS
{
	. = KERNEL_PA_BASE;

	.early : ALIGN(4K) {
		*(.multiboot)
		*(.text.low)
	}

	.bss.pagetables : ALIGN(4K) {
		*(.bss.pagatables)
	}

	. += KERNEL_VA_BASE;
	
	.text ALIGN(4K) : AT(ADDR(.text) - KERNEL_VA_BASE) {
		_kernel_text_start = .;
		*(.text)
		_kernel_text_end = .;
	}
	
	.rodata ALIGN(4K) : AT(ADDR(.rodata) - KERNEL_VA_BASE) {
		*(.rodata)
	}
 
	.data ALIGN(4K) : AT(ADDR(.data) - KERNEL_VA_BASE) {
		*(.data)
		SECT_KTESTS
	}
 
	.bss ALIGN(4K) : AT(ADDR(.bss) - KERNEL_VA_BASE) {
		*(COMMON)
		*(.bss)
		. = ALIGN(PAGE_NBYTES);
	}

	_kernel_pa_end = . - KERNEL_VA_BASE;
	_kernel_va_end = .;
}
